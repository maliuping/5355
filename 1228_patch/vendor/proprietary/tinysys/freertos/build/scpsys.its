## 1228_patch/vendor/proprietary/tinysys/freertos/build/scpsys.its
```
/dts-v1/;

/ {
        description = "scpsys fitImage for fastrvc";
        #address-cells = <1>;
		images {
			scpsys@1 {
				description = "scp firmware";
				data = /incbin/("scpsys.bin");
				type = "kernel";
				compression = "none";
				load = <0x130000>;
				hash@1 {
					algo = "sha256";
				};
			};
		};

		configurations {
                default = "conf@1";
                conf@1 {
                        description = "scp firmware";
                        kernel = "scpsys@1";
                        signature@1 {
                                algo = "sha256,rsa2048";
                                key-name-hint="dev";
                                sign-images="kernel";
                        };
                };
        };
};
```

## 1228_patch/vendor/proprietary/tinysys/freertos/middleware/fastrvc/pics/scpdata.its
```
/dts-v1/;

/ {
		description = "scp fitImage for fastrvc";
		#address-cells = <1>;
		images {
			logo {
				description = "logo";
				data = /incbin/("scp-logo.lz4");
				type = "loadable";
				compression = "lz4";
				load = <0x4D000000>;
				hash@1 {
					algo = "sha256";
				};
			};

			guideline {
				description = "guideline";
				data = /incbin/("scp-guideline.lz4");
				type = "loadable";
				compression = "lz4";
				load = <0x4D800000>;
				hash@1 {
					algo = "sha256";
				};
			};

			warnmsg {
				description = "warning message";
				data = /incbin/("scp-warning.lz4");
				type = "loadable";
				compression = "lz4";
				load = <0x4E000000>;
				hash@1 {
					algo = "sha256";
				};
			};
		};
};
```
